## esp/main/Kconfig.projbuild
```kconfig
menu "WiFi Headphones Configuration"
    config HEADPHONES_NAME
        string "Headphones name"
        default "WiFi Headphones"
        help
            The name that the discovery server will send

    menu "WiFi conf"
        config WIFI_SSID
            string "WiFi SSID"
            default "myssid"
            help
                SSID (network name) for the example to connect to.

        config WIFI_PASSWORD
            string "WiFi Password"
            default "mypassword"
            help
                WiFi password (WPA or WPA2) for the example to use.

        config WIFI_MAXIMUM_RETRY
            int "Maximum retry"
            default 5
            help
                Set the Maximum retry to avoid station reconnecting to the AP unlimited when the AP is really inexistent.

        config WIFI_PW_ID
            string "PASSWORD IDENTIFIER"
            default ""
            help
                password identifier for SAE H2E
    endmenu

    menu "Hardware conf"
        config I2S_BCLK_GPIO
            int "I2S BCLK GPIO"
            default 26
            range 2 39

        config I2S_WS_GPIO
            int "I2S WS GPIO"
            default 25
            range 2 39

        config I2S_DIN_GPIO
            int "I2S DIN GPIO"
            default 22
            range 2 39
    endmenu

endmenu
```
